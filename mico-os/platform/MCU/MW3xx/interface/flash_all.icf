/*###ICF### Section handled by ICF editor, don't touch! ****/
/*-Editor annotation file-*/
/* IcfEditorFile="$TOOLKIT_DIR$\config\ide\IcfEditor\cortex_v1_0.xml" */
/*-Specials-*/

/*-Memory Regions-*/
define symbol __ICFEDIT_region_ROM_start__ = 0x1f000000;
define symbol __ICFEDIT_region_ROM_end__   = 0x1f200000;
define symbol __ICFEDIT_region_RAM_start__ = 0x0011C000;
define symbol __ICFEDIT_region_RAM_end__   = 0x00128000;
/*-Sizes-*/

/**** End of ICF editor section. ###ICF###*/

define memory mem with size = 4G;
define region ROM_region   = mem:[from __ICFEDIT_region_ROM_start__   to __ICFEDIT_region_ROM_end__];
define region RAM_region   = mem:[from __ICFEDIT_region_RAM_start__   to __ICFEDIT_region_RAM_end__];


place at start of ROM_region  {section MYSEC};


